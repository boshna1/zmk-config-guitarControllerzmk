/ {
	chosen {
		zmk,kscan = &default_kscan;
	};

	default_kscan: kscan {
		compatible = "zmk,kscan-gpio-direct";
		label = "default_kscan";

		input-gpios = 
			<&pro_micro 7 (GPIO_ACTIVE_HIGH | GPIO_PULL_DOWN)>,
			<&pro_micro 6 (GPIO_ACTIVE_HIGH | GPIO_PULL_DOWN)>,
			<&pro_micro 5 (GPIO_ACTIVE_HIGH | GPIO_PULL_DOWN)>,
			<&pro_micro 4 (GPIO_ACTIVE_HIGH | GPIO_PULL_DOWN)>,
			<&pro_micro 3 (GPIO_ACTIVE_HIGH | GPIO_PULL_DOWN)>,
			<&pro_micro 11 (GPIO_ACTIVE_HIGH | GPIO_PULL_DOWN)>,
			<&pro_micro 12 (GPIO_ACTIVE_HIGH | GPIO_PULL_DOWN)>,
			<&pro_micro 13 (GPIO_ACTIVE_HIGH | GPIO_PULL_DOWN)>,
			<&pro_micro 14 (GPIO_ACTIVE_HIGH | GPIO_PULL_DOWN)>
	};

};